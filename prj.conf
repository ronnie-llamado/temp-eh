## CMakeLists.txt
```
cmake_minimum_required(VERSION 3.20.0)

find_package(Zephyr REQUIRED HINTS $ENV{ZEPHYR_BASE})
project(temp-eh)

zephyr_include_directories(include)

add_subdirectory(lib)

target_sources(app PRIVATE
	src/main.cpp
	src/zephyr_i2c.cpp
	src/bme680_cal.cpp
)
```

## Kconfig
```
if ANT

rsource "lib/Kconfig"

endif # ANT

source "Kconfig.zephyr"
```

## west.yml
```
manifest:
  version: "0.13"

  remotes:
    - name: ant-nrfconnect
      url-base: https://github.com/ant-nrfconnect
    - name: ncs
      url-base: https://github.com/nrfconnect

  projects:
    - name: sdk-ant
      remote: ant-nrfconnect
      revision: main
      import: true
    - name: nrf
      remote: ncs
      revision: v3.4.1
      import: true

  self:
    path: temp-eh
```

## prj.conf
```kconfig
CONFIG_CPP=y
CONFIG_REQUIRES_FULL_LIBCPP=y

CONFIG_USE_SEGGER_RTT=y
CONFIG_RTT_CONSOLE=y
CONFIG_UART_CONSOLE=n

CONFIG_SEGGER_RTT_BUFFER_SIZE_UP=2048

CONFIG_GPIO=y
CONFIG_I2C=y

CONFIG_ANT=y
CONFIG_FPU=y
CONFIG_FP_HARDABI=y
CONFIG_ANT_EVALUATION_KEY=y

CONFIG_ANT_ENV=y
```

## src/main.cpp
```c
#include <zephyr/kernel.h>

static uint32_t count = 0;

int main(void)
{
	while(1)
	{
		printk("Alive (%d)!\r\n", count++);
		k_sleep(K_SECONDS(1));
	}
}
```

## src/bme680.hpp
```c
#pragma once

#include <stdint.h>

#include "bme680_cal.hpp"

constexpr uint8_t TEMP_MSB = 0x22;
constexpr uint8_t TEMP_LSB = 0x23;
constexpr uint8_t TEMP_XLSB = 0x24;
constexpr uint8_t CTRL_MEAS = 0x74;
constexpr uint8_t T2_LSB = 0x8A;
constexpr uint8_t T2_MSB = 0x8B;
constexpr uint8_t T3 = 0x8C;
constexpr uint8_t CHIP_ID = 0xD0;
constexpr uint8_t T1_LSB = 0xE9;
constexpr uint8_t T1_MSB = 0xEA;

struct Mode {
  using Type = uint8_t;

  static constexpr Type SLEEP = 0;
  static constexpr Type FORCED = 1;
};

struct OsrsTemp {
  using Type = uint8_t;

  static constexpr Type SKIPPED = 0 << 5;
  static constexpr Type X1 = 1 << 5;
  static constexpr Type X2 = 2 << 5;
  static constexpr Type X4 = 3 << 5;
  static constexpr Type X8 = 4 << 5;
  static constexpr Type X16 = 5 << 5;
};

template <typename Bus>
class Bme680 {
 public:
  explicit Bme680(Bus& bus, uint8_t addr) : bus_(bus), addr_(addr) {}

  int configureTempOsr(OsrsTemp::Type osr);
  int readTempCal1(void);
  int readTempCal2(void);
  int readTempCal3(void);
  int readChipId(uint8_t* chipId);
  int readTempInt(int16_t* temp);
  int triggerMeasurement(void);

 protected:
  int readRawTemp(uint32_t* rawTemp);

 private:
  Bus& bus_;
  uint8_t addr_;

  bme680::temp_cal_t temp_cal_;

  OsrsTemp::Type osrs_temp_ = OsrsTemp::SKIPPED;
};

template <typename Bus>
int Bme680<Bus>::configureTempOsr(OsrsTemp::Type osr) {
  osrs_temp_ = osr;
  return 0;
}

template <typename Bus>
int Bme680<Bus>::readTempCal1(void) {
  return bus_.readRegister16(addr_, T1_LSB, &temp_cal_.T1);
}

template <typename Bus>
int Bme680<Bus>::readTempCal2(void) {
  return bus_.readRegister16(addr_, T2_LSB, &temp_cal_.T2);
}

template <typename Bus>
int Bme680<Bus>::readTempCal3(void) {
  return bus_.readRegister8(addr_, T3, &temp_cal_.T3);
}

template <typename Bus>
int Bme680<Bus>::readChipId(uint8_t* chipId) {
  return bus_.readRegister8(addr_, CHIP_ID, chipId);
}

template <typename Bus>
int Bme680<Bus>::readRawTemp(uint32_t* rawTemp) {
  uint8_t raw[3];

  bus_.readRegister(addr_, TEMP_MSB, &raw[0], 3);
  *rawTemp = (raw[0] << 12) + (raw[1] << 4) + (raw[2] >> 4);

  return 0;
}

template <typename Bus>
int Bme680<Bus>::readTempInt(int16_t* temp) {
  uint32_t rawTemp = 0;

  readRawTemp(&rawTemp);
  *temp = bme680::compensateTempInt(&temp_cal_, rawTemp);

  return 0;
}

template <typename Bus>
int Bme680<Bus>::triggerMeasurement(void) {
  uint8_t data = (uint8_t)(osrs_temp_ | Mode::FORCED);
  return bus_.writeRegister8(addr_, CTRL_MEAS, data);
}
```

## src/bme680_cal.cpp
```c
#include "bme680_cal.hpp"

namespace bme680 {

int16_t compensateTempInt(const temp_cal_t* cal, uint32_t rawTemp) {
  int32_t var1 = ((int32_t)rawTemp >> 3) - ((int32_t)cal->T1 << 1);
  int32_t var2 = (var1 * (int32_t)cal->T2) >> 11;
  int32_t var3 =
      ((((var1 >> 1) * (var1 >> 1)) >> 12) * ((int32_t)cal->T3 << 4)) >> 14;
  int32_t t_fine = var2 + var3;
  return (((t_fine * 5) + 128) >> 8);
}

}  // namespace bme680
```

## src/bme680_cal.hpp
```c
#pragma once

#include <stdint.h>

namespace bme680 {

struct temp_cal_t {
  uint16_t T1;
  uint16_t T2;
  uint8_t T3;
};

int16_t compensateTempInt(const temp_cal_t* cal, uint32_t rawTemp);

}  // namespace bme680
```

## src/i2c.hpp
```c
#pragma once

#include <stdint.h>
#include <stdlib.h>

template <typename T>
class I2cBus {
 public:
  explicit I2cBus(T& t) : t_(t) {}

  int read(uint8_t addr, uint8_t* rx, size_t len) {
    return t_.read(addr, rx, len);
  }

  int write(uint8_t addr, const uint8_t* tx, size_t len) {
    return t_.write(addr, tx, len);
  }

  int writeRead(uint8_t addr,
                const uint8_t* tx,
                size_t txLen,
                uint8_t* rx,
                size_t rxLen) {
    return t_.writeRead(addr, tx, txLen, rx, rxLen);
  }

  // Register Helpers
  int readRegister(uint8_t addr, uint8_t reg, uint8_t* rx, size_t len)
  {
    return writeRead(addr, &reg, 1, rx, len);
  }

  int readRegister8(uint8_t addr, uint8_t reg, uint8_t *data)
  {
    return writeRead(addr, &reg, 1, data, 1);
  }

  int readRegister16(uint8_t addr, uint8_t reg, uint16_t *data)
  {
    uint8_t rx[2];
    writeRead(addr, &reg, 1, &rx[0], 2);
    *data = (rx[1] << 8) + rx[0];
    return 0;
  }

  int writeRegister8(uint8_t addr, uint8_t reg, uint8_t data)
  {
    uint8_t tx[2] = { reg, data };
    return write(addr, &tx[0], 2);
  }

 private:
  T& t_;
};
```

## src/led.cpp
```c
#include <zephyr/drivers/gpio.h>
#include <zephyr/kernel.h>
#include <zephyr/sys/printk.h>

#define SLEEP_TIME_S 1
#define LED0_NODE DT_ALIAS(led0)

#define LED_STACK_SIZE 1024
#define LED_PRIORITY 5

static const struct gpio_dt_spec led = GPIO_DT_SPEC_GET(LED0_NODE, gpios);

static void led_thread(void* p1, void* p2, void* p3) {
  ARG_UNUSED(p1);
  ARG_UNUSED(p2);
  ARG_UNUSED(p3);

  int ret;
  bool led_state = true;

  if (!gpio_is_ready_dt(&led)) {
    return;
  }

  ret = gpio_pin_configure_dt(&led, GPIO_OUTPUT_ACTIVE);
  if (ret < 0) {
    return;
  }

  while (1) {
    ret = gpio_pin_toggle_dt(&led);
    if (ret < 0) {
      return;
    }

    led_state = !led_state;
    printk("LED state: %s\n", led_state ? "ON" : "OFF");
    k_sleep(K_SECONDS(1));
  }

  return;
}

K_THREAD_DEFINE(
    led_tid, LED_STACK_SIZE, led_thread, NULL, NULL, NULL, LED_PRIORITY, 0, 0);
```

## src/temperature.cpp
```c
#include <zephyr/device.h>
#include <zephyr/devicetree.h>
#include <zephyr/drivers/sensor.h>
#include <zephyr/drivers/sensor_data_types.h>
#include <zephyr/dsp/print_format.h>
#include <zephyr/kernel.h>
#include <zephyr/rtio/rtio.h>

#define TEMPERATURE_STACK_SIZE 1024
#define TEMPERATURE_PRIORITY 4

static void temperature_thread(void* p1, void* p2, void* p3) {
  ARG_UNUSED(p1);
  ARG_UNUSED(p2);
  ARG_UNUSED(p3);

  const struct device* const dev = DEVICE_DT_GET_ONE(bosch_bme680);
  struct sensor_value temp, press, humidity, gas_res;

  if (!device_is_ready(dev)) {
    printk("sensor: device not ready.\n");
    return;
  }

  printk("Device %p name is %s\n", dev, dev->name);

  while (1) {
    k_sleep(K_MSEC(3000));

    sensor_sample_fetch(dev);
    sensor_channel_get(dev, SENSOR_CHAN_AMBIENT_TEMP, &temp);
    sensor_channel_get(dev, SENSOR_CHAN_PRESS, &press);
    sensor_channel_get(dev, SENSOR_CHAN_HUMIDITY, &humidity);
    sensor_channel_get(dev, SENSOR_CHAN_GAS_RES, &gas_res);

    printk("T: %d.%06d; P: %d.%06d; H: %d.%06d; G: %d.%06d\n",
           temp.val1,
           temp.val2,
           press.val1,
           press.val2,
           humidity.val1,
           humidity.val2,
           gas_res.val1,
           gas_res.val2);
  }

  return;
}

K_THREAD_DEFINE(temperature_tid,
                TEMPERATURE_STACK_SIZE,
                temperature_thread,
                NULL,
                NULL,
                NULL,
                TEMPERATURE_PRIORITY,
                0,
                0);
```

## src/zephyr_i2c.cpp
```c
#include "zephyr_i2c.hpp"

#include <zephyr/drivers/i2c.h>

int ZephyrI2cBus::read(uint8_t addr, uint8_t* rx, size_t len) {
  return i2c_read(dev_, rx, len, addr);
}

int ZephyrI2cBus::write(uint8_t addr, const uint8_t* tx, size_t len) {
  return i2c_write(dev_, tx, len, addr);
}

int ZephyrI2cBus::writeRead(
    uint8_t addr, const uint8_t* tx, size_t txLen, uint8_t* rx, size_t rxLen) {
  return i2c_write_read(dev_, addr, tx, txLen, rx, rxLen);
}
```

## src/zephyr_i2c.hpp
```c
#pragma once

#include <stdint.h>
#include <stdlib.h>
#include <zephyr/device.h>

class ZephyrI2cBus {
 public:
  explicit ZephyrI2cBus(const struct device* dev) : dev_(dev) {}

  int read(uint8_t addr, uint8_t* rx, size_t len);
  int write(uint8_t addr, const uint8_t* tx, size_t len);
  int writeRead(
      uint8_t addr, const uint8_t* tx, size_t txLen, uint8_t* rx, size_t rxLen);

 private:
  const struct device* dev_;
};
```
